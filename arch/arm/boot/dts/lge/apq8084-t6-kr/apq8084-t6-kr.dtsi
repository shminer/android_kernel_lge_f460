/* Copyright (c) 2012, Code Aurora Forum. All rights reserved.
 *
 * This program is free software; you can redistribute it and/or modify
 * it under the terms of the GNU General Public License version 2 and
 * only version 2 as published by the Free Software Foundation.
 *
 * This program is distributed in the hope that it will be useful,
 * but WITHOUT ANY WARRANTY; without even the implied warranty of
 * MERCHANTABILITY or FITNESS FOR A PARTICULAR PURPOSE.  See the
 * GNU General Public License for more details.
 */

#include "apq8084-t6-kr-panel.dtsi"
#include "apq8084-t6-kr-sensor.dtsi"
#include "apq8084-t6-kr-sound.dtsi"
#include "apq8084-t6-kr-usb.dtsi"
#include "apq8084-t6-kr-input.dtsi"
#include "apq8084-t6-kr-misc.dtsi"
#include "apq8084-t6-kr-pm.dtsi"
#include "apq8084-t6-kr-camera.dtsi"
#include "apq8084-t6-kr-mmc.dtsi"
#include "apq8084-t6-kr-nfc.dtsi"
#include "apq8084-t6-kr-bt.dtsi"
#include "apq8084-t6-kr-tdmb.dtsi"
#include "apq8084-t6-kr-wifi.dtsi"
