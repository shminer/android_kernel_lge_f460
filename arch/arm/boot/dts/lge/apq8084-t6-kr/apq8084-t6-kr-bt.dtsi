/* Copyright (c) 2012, Code Aurora Forum. All rights reserved.
 *
 * This program is free software; you can redistribute it and/or modify
 * it under the terms of the GNU General Public License version 2 and
 * only version 2 as published by the Free Software Foundation.
 *
 * This program is distributed in the hope that it will be useful,
 * but WITHOUT ANY WARRANTY; without even the implied warranty of
 * MERCHANTABILITY or FITNESS FOR A PARTICULAR PURPOSE.  See the
 * GNU General Public License for more details.
 */

&soc {
	uart6: uart@f9922000 { //BLSP6
		status = "ok";
	};

	/*To register rfkill*/
	bt_rfkill {
		status = "ok";
	};

	/* To register BT wake-up devices for BT sleep */
	bt_sleep {
		status = "ok";
	};
};
