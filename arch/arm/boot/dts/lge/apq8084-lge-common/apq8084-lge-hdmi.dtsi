/* Copyright (c) 2012, Code Aurora Forum. All rights reserved.
 *
 * This program is free software; you can redistribute it and/or modify
 * it under the terms of the GNU General Public License version 2 and
 * only version 2 as published by the Free Software Foundation.
 *
 * This program is distributed in the hope that it will be useful,
 * but WITHOUT ANY WARRANTY; without even the implied warranty of
 * MERCHANTABILITY or FITNESS FOR A PARTICULAR PURPOSE.  See the
 * GNU General Public License for more details.
 */
&soc {
	i2c_2: i2c@f9927000 {
		analogix_anx7816@72 {
			compatible = "analogix,anx7816";
			status = "ok";
			reg = <0x72>;
			interrupt-parent = <&pma8084_gpios>;
			interrupts = <11 0x2>;
			analogix,reset-gpio = <&pma8084_gpios 17 0x0>;
			analogix,irq-gpio = <&msmgpio 103 0x0>;
			analogix,p-dwn-gpio = <&pma8084_gpios 13 0x0>;
			analogix,cbl-det-gpio = <&pma8084_gpios 11 0x0>;
			analogix,v10-ctrl-gpio = <&pma8084_mpps 2 0x0>;
			analogix,v33-ctrl-gpio = <&pma8084_mpps 4 0x0>;
			analogix,i2c-pull-up = <1>;
			qcom,hdmi-tx-map = <&mdss_hdmi_tx>;
		};

	};

	qcom,hdmi_tx@fd922100 {
		qcom,supply-names = "hpd-gdsc", "hpd-5v", "core-vdda", "core-vcc";
	};
};
