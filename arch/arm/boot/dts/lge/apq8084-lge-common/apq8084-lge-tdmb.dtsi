/*
 * Copyright (c) 2012, The Linux Foundation. All rights reserved.
 *
 * This program is free software; you can redistribute it and/or modify
 * it under the terms of the GNU General Public License version 2 and
 * only version 2 as published by the Free Software Foundation.
 *
 * This program is distributed in the hope that it will be useful,
 * but WITHOUT ANY WARRANTY; without even the implied warranty of
 * MERCHANTABILITY or FITNESS FOR A PARTICULAR PURPOSE.  See the
 * GNU General Public License for more details.
 */

/ {

	soc {
		spi_tdmb: spi@f9923000 { /* BLSP-1 QUP0 */
			compatible = "qcom,spi-qup-v2";
			status = "disable";
			reg-names = "spi_physical", "spi_bam_physical";
			reg = <0xf9923000 0x1000>, <0xf9904000 0x19000>;
			interrupt-names = "spi_irq", "spi_bam_irq";
			interrupts = <0 95 0>, <0 238 0>;
			spi-max-frequency = <15000000>;
			#address-cells = <1>;
			#size-cells = <0>;
			qcom,gpio-mosi = <&msmgpio 0 0>;
			qcom,gpio-miso = <&msmgpio 1 0>;
			qcom,gpio-clk = <&msmgpio 3 0>;
			qcom,gpio-cs0 = <&msmgpio 2 0>;

			/delete-property/ qcom,gpio-cs1;
			/delete-property/ qcom,gpio-cs3;
			/delete-property/ qcom,infinite-mode;
			qcom,use-bam;
			qcom,bam-consumer-pipe-index = <12>;
			qcom,bam-producer-pipe-index = <13>;
			qcom,ver-reg-exists;
			/delete-property/ qcom,master-id;
		};
	};
};

&spi_tdmb {
	tdmb@0 {
		compatible = "lge,tdmb";
		status = "disable";
		reg = <0>;
		interrupt-parent = <&msmgpio>;
		interrupts = <60 0x0>;
		spi-max-frequency = <15000000>;

		tdmb-fc8080,irq-gpio = <&msmgpio 60 0x00>;
		tdmb-fc8080,en-gpio = <&msmgpio 59 0x00>;
	};
};

