/* Copyright (c) 2012, Code Aurora Forum. All rights reserved.
 *
 * This program is free software; you can redistribute it and/or modify
 * it under the terms of the GNU General Public License version 2 and
 * only version 2 as published by the Free Software Foundation.
 *
 * This program is distributed in the hope that it will be useful,
 * but WITHOUT ANY WARRANTY; without even the implied warranty of
 * MERCHANTABILITY or FITNESS FOR A PARTICULAR PURPOSE.  See the
 * GNU General Public License for more details.
 */

&usb3 {
	compatible = "qcom,dwc-usb3-msm";
	reg = <0xf9200000 0xfc000>, <0xfd4ab000 0x4>;
	qcom,dwc-vadc = <&pma8084_vadc>;
	vbus_dwc3-supply = <&pma8084_mvs1>;
};

&ssphy0 {
	qcom,rx-eq-value = <0x03>;
	qcom,tx-amplitude-value = <0x7F>;
	qcom,deemphasis-value = <0x30>;
};
