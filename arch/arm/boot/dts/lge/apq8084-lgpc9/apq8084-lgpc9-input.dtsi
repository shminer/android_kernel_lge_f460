/* Copyright (c) 2012, Code Aurora Forum. All rights reserved.
 *
 * This program is free software; you can redistribute it and/or modify
 * it under the terms of the GNU General Public License version 2 and
 * only version 2 as published by the Free Software Foundation.
 *
 * This program is distributed in the hope that it will be useful,
 * but WITHOUT ANY WARRANTY; without even the implied warranty of
 * MERCHANTABILITY or FITNESS FOR A PARTICULAR PURPOSE.  See the
 * GNU General Public License for more details.
 */

&soc {
	i2c@f9966000 {
		synaptics_s3528@20 {
			status = "ok";
			fw_image_s3528_a0 = "synaptics/g3_kr/PLG313-V1.06-PR1650170-DS5.5.1.0.1066_30055186_S3528A0.img";
			fw_image_s3528_a1 = "synaptics/g3_kr/PLG313-V1.22-PR1653201-DS5.5.1.0.1066_30055196_S3528A1.img";
			fw_image_s3621 = "synaptics/g3_kr/PLG298-F004.img";
			panel_spec = "synaptics/g3_kr/g3_kr_limit.txt";
		};
	};
};
