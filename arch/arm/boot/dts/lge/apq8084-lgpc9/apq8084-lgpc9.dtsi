/* Copyright (c) 2012, Code Aurora Forum. All rights reserved.
 *
 * This program is free software; you can redistribute it and/or modify
 * it under the terms of the GNU General Public License version 2 and
 * only version 2 as published by the Free Software Foundation.
 *
 * This program is distributed in the hope that it will be useful,
 * but WITHOUT ANY WARRANTY; without even the implied warranty of
 * MERCHANTABILITY or FITNESS FOR A PARTICULAR PURPOSE.  See the
 * GNU General Public License for more details.
 */

#include "apq8084-lgpc9-panel.dtsi"
#include "apq8084-lgpc9-sensor.dtsi"
#include "apq8084-lgpc9-sound.dtsi"
#include "apq8084-lgpc9-usb.dtsi"
#include "apq8084-lgpc9-input.dtsi"
#include "apq8084-lgpc9-misc.dtsi"
#include "apq8084-lgpc9-pm.dtsi"
#include "apq8084-lgpc9-camera.dtsi"
#include "apq8084-lgpc9-mmc.dtsi"
#include "apq8084-lgpc9-nfc.dtsi"
#include "apq8084-lgpc9-bt.dtsi"
#include "apq8084-lgpc9-wifi.dtsi"
