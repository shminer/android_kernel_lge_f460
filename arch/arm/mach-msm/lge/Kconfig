## arch/arm/mach-msm/lge/Kconfig
```kconfig
config MACH_LGE
	bool

menu "LGE Board Selection"

config MACH_APQ8084_LGPC9
	depends on ARCH_APQ8084
	select MACH_LGE
	bool "APQ8084 LGPC9"
	help
	  Support for the Qualcomm APQ8084 LGPC9 device.

config MACH_APQ8084_T6_KR
	depends on ARCH_APQ8084
	select MACH_LGE
	bool "APQ8084 T6 KR"
	help
	  Support for the Qualcomm APQ8084 T6 KR device.

config MACH_APQ8084_T6_LGU
	depends on ARCH_APQ8084
	select MACH_LGE
	bool "APQ8084 T6 LGU"
	help
	  Support for the Qualcomm APQ8084 T6 LGU device.

config MACH_APQ8084_T6_KT
	depends on ARCH_APQ8084
	select MACH_LGE
	bool "APQ8084 T6 KT"
	help
	  Support for the Qualcomm APQ8084 T6 KT device.

config MACH_APQ8084_T6_SKT
	depends on ARCH_APQ8084
	select MACH_LGE
	bool "APQ8084 T6 SKT"
	help
	  Support for the Qualcomm APQ8084 T6 SKT device.

endmenu

config DTS_TARGET
	string "DTS target dir"
	default "apq8084-lgpc9" if MACH_APQ8084_LGPC9
	help
	  CONFIG_DTS_TARGET should be set to support appended dts.
	  ex) CONFIG_DTS_TARGET="apq8084-lgpc9".


menu "LGE Specific Patches"

config LGE_USES_SMD_DS_TTY
	bool "Explicitly use smd tty driver for DS"
	default n
	depends on MSM_SMD_TTY && MACH_LGE
	help
	  In Qualcomm MSM8960, smd tty driver for ds(/dev/smd0) is not used.
	  Say yes if this tty driver must be used on LGE device. This is used
	  to connect smd channel in user space(for example, ATCMD processing).

config DEBUG_USER_INIT
	bool "Print debug messages for init process only"
	default n
	depends on DEBUG_USER
	help
	  Print the init process debug message only.

config LGE_BOOTLOADER_LOG
	tristate "Support LGE bootloader log"
	default n
	depends on MACH_LGE
	help
	  LGE bootloader log

config LGE_HANDLE_PANIC
	tristate "Support LGE Kernel Panic Handler"
	default n
	depends on MACH_LGE
	help
	  LGE Error handler

config LGE_MEMORY_INFO
	bool "Show Additional Memory Information"
	default n
	depends on MACH_LGE
	help
	  If you want to show additional memory information by /proc/meminfo or
	  /proc/zoneinfo, set this setting.
	  This configuration show page size for vmalloc, binder, kgsl, ion, and iommu.

config LGE_LCD_TUNING
	bool "lcd_gamma_tuning"
	default n
	depends on MACH_LGE
	help
	  Support LCD gamma tuning.

config LGE_BOOTLOADER_TIME_CHECKER
	bool "Show bootloader(LK, SBL) time"
	default n
	depends on MACH_LGE
	help
	  This shows the lk and sbl1 booting time in MSM8974.
	  If this feature is enabled, it should be check by adb shell.
	  Device Node : sys/module/lge_bootloader_time_checker/

config LGE_ECO_MODE
	tristate "Support LGE ECO Mode"
	default n
	depends on MACH_LGE
	help
	  LGE ECO mode support

config LGE_ENABLE_MMC_STRENGTH_CONTROL
	bool "Support MMC Strength Control"
	default n
	depends on MACH_LGE
	help
	  LGE mmc data,cmd,clk strength control support

config LGE_BNR_RECOVERY_REBOOT
	bool "Support PC suite BNR recovery reboot"
	default n
	depends on MACH_LGE
	help
	  Support PC suite BNR recovery reboot. bnr recovery mode
	  could be entered with reboot --bnr_recovery cmd.

config LGE_PROBE_TIME_PROFILING
	bool "Support kernel driver probe time profiling"
	default n
	depends on MACH_LGE
	help
	  Support kernel driver probe time profiling.

config LGE_MSM_HSIC_TTY
	bool "LGE HSIC TTY Driver"
	default n
	depends on MACH_LGE
	help
	  Provides a TTY driver HSIC TTY
	  This driver can be used by user space
	  applications for passing data through the
	  HSIC interface.

config LGE_MSM_PCIE
	bool "LGE specific MSM PCIe Controller driver"
	default n
	depends on MACH_LGE && MSM_PCIE
	help
	  Enables the PCIe functionality by configures PCIe core on
	  MSM chipset and by enabling the ARM PCI framework extension.

config LGE_USB_XHCI_MSM_HSIC
	bool "LGE specific HSIC based MSM on-chip XHCI USB controller"
	default n
	depends on MACH_LGE && USB_XHCI_MSM_HSIC
	help
	  Enables support for the HSIC (High Speed Inter-Chip) based
	  USB Host controller present on the Qualcomm chipsets.

config LGE_PSEUDO_CHG_UI
	bool "LGE specific PSEUDO charging UI"
	default n
	depends on MACH_LGE
	help
	  Enable the PSEUDO charging UI.

config LGE_KSWITCH
	tristate "Support LGE Kill Switch"
	default n
	depends on MACH_LGE
	help
	  LGE Kill Switch

endmenu
menu "LGE QFPROM Values"

config LGE_QFPROM_INTERFACE
	bool "Support qfprom interface"
	default n
	depends on MACH_LGE
	help
	  LGE QFPROM DRIVER.

config LGE_QFPROM_SECHASH
	string "Support qfprom sec hash"
	default 0x0
	depends on LGE_QFPROM_INTERFACE
	help
	  LGE QFPROM DRIVER-SEC partition's hash value.
endmenu
```

## drivers/broadcast/Kconfig
```kconfig
# LGE Broadcast Device Driver Support

menu "LGE Broadcast Device Support"

config LGE_BROADCAST_TDMB
	bool "LGE broadcast TDMB device Driver"
	depends on (MACH_APQ8084_T6_KR)
	default y
	help
	  Select this if you want to use TDMB broadcast service

source "drivers/broadcast/tdmb/Kconfig"
endmenu
```

## drivers/broadcast/tdmb/Kconfig
```kconfig
#menu "BROADCAST_DEVICE"

#
# Broadcast Device Driver Support
#

#menu "BROADCAST_DEVICE"

config LGE_BROADCAST_TDMB_FC8080
	bool "LGE broacast TDMB FC8080 device"
	depends on (LGE_BROADCAST_TDMB && MACH_APQ8084_T6_KR)
	default y
	help
	  Select this if you want to use broadcast service

#endmenu
```

## drivers/nfc/Kconfig
```kconfig
#
# Near Field Communication (NFC) devices
#

menu "Near Field Communication (NFC) devices"
	depends on NFC

config LGE_NFC
	bool "NFC Device Enabled for LGE"
	default n

config LGE_NFC_PN544_C2
	bool "PN544 C2 NFC driver"
	depends on I2C
	select CRC_CCITT
	default n
	---help---
	  Say yes if you want PN544 Near Field Communication driver.
	  This is for i2c connected version. If unsure, say N here.

	  To compile this driver as a module, choose m here. The module will
	  be called pn544.


config LGE_NFC_PN544_C3
	bool "PN544 C3 NFC driver"
	depends on I2C
	select CRC_CCITT
	default n
	---help---
	  Say yes if you want PN544 Near Field Communication driver.
	  This is for i2c connected version. If unsure, say N here.

	  To compile this driver as a module, choose m here. The module will
	  be called pn544.

config LGE_NFC_PN547_C2
	bool "PN547 C2 NFC driver"
	depends on I2C
	select CRC_CCITT
	default n
	---help---
	  Say yes if you want PN547 Near Field Communication driver.
	  This is for i2c connected version. If unsure, say N here.

	  To compile this driver as a module, choose m here. The module will
	  be called pn547.

config LGE_NFC_PRESTANDBY
	bool "NFC STANBY MODE"
	default n
	---help---
	  Say yes if you want to change a power state of pn544 to stanby mode in Kernel.
	  If unsure, say N here.

config LGE_NFC_MULTICORE_FASTBOOT
	bool "NFC MultiThread"
	default n
	---help---
	  Say yes if multi thread is applied for pre-standby.
	  If unsure, say N here.

config LGE_NFC_SET_IRQ_WAKEUP
	bool "NFC Set IRQ wakeup when NFC ON"
	default n
	---help---
	  Say yes if Set IRQ Wakeup NFC ON.
	  If unsure, say N here.

config LGE_NFC_DEBUG_MESSAGE
	bool "NFC Debug Message"
	default n

config LGE_NFC_USE_PMIC
	bool "NFC Using PMIC Clock"
	default n
	---help---
	  Say yes if you want to use PMIC Clock.
	  If use XTAL or unsure, say N here.
	  Please refer to [NFC-367] for more details.

endmenu
```

## drivers/soc/qcom/lge/Kconfig
```kconfig
config MACH_LGE
	bool "Machine LGE"
	help
	  Support for machine LGE.

menu "LGE Specific Patches"

config LGE_PM_UNIFIED_NODE
	bool "enable LGE PM Unified sysfs node"
	help
	  Support LGE PM Unified sysfs node

endmenu
```

## drivers/video/slimport/Kconfig
```kconfig
config SLIMPORT_ANX7816
	tristate "Analogix Slimport transmitter ANX7816 support"
	help
	  Slimport Transmitter is a 2K/4K video transmitter chip
	  over micro-USB connector for smartphone device.

config SLIMPORT_ANX7808
	tristate "Analogix Slimport transmitter ANX7808 support"
	help
	  Slimport Transmitter is a full HD video transmitter chip
	  over micro-USB connector for smartphone device.

config SLIMPORT_DYNAMIC_HPD
	tristate "Slimport support for dynamic HDMI HPD control"
	depends on SLIMPORT_ANX7816 || SLIMPORT_ANX7808
	help
	  Slimport set HPD when cable is connected,
	  HDMI clk is off during slimport cable is not connected

config SLIMPORT_COMMON
	tristate "Slimport common functions for HDMI transmitter"
	depends on SLIMPORT_ANX7816 || SLIMPORT_ANX7808
	help
	  This supports utilities for HDMI with slimport
```
